## config/boards/shields/Kconfig.defconfig
```kconfig
if SHIELD_MACROETRNTC

config ZMK_KEYBOARD_NAME
    default "macropadobs"

endif
```

## config/boards/shields/macropadobs/Kconfig.defconfig
```kconfig
if SHIELD_MACROPADOBS

config ZMK_KEYBOARD_NAME
    default "macropadobs"

endif
```

## config/west.yml
```yaml
manifest:
  remotes:
    - name: zmkfirmware
      url-base: https://github.com/zmkfirmware
    - name: h4kdevops
      url-base: https://github.com/h4kdevops
    # Additional modules containing boards/shields/custom code can be listed here as well
    # See https://docs.zephyrproject.org/3.2.0/develop/west/manifest.html#projects
  projects:
    - name: zmk
      remote: zmkfirmware
      revision: main
      import: app/west.yml
    - name: macropadobs-zmk-module
      remote: h4kdevops
      clone-depth: 1
      revision: main
  self:
    path: config
```
